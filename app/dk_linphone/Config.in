## app/dk_linphone/Config.in
```kconfig
config AOS_APP_DK_LINPHONE
    bool "DeveloperKit GUI Sample"
    select AOS_COMP_LITTLEVGL
    select AOS_COMP_CLI
    select AOS_COMP_YLOOP
    help
        Linphone test for Developer Kit

if AOS_APP_DK_LINPHONE
# Configurations for app dk_gui
endif
```
